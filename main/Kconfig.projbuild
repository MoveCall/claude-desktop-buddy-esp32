## main/Kconfig.projbuild
```kconfig
menu "Claude Desktop Buddy"

choice BOARD_TYPE
    prompt "Board Type"
    default BOARD_TYPE_MOVECALL_CUICAN_ESP32S3
    help
        Select the target hardware board.

    config BOARD_TYPE_MOVECALL_CUICAN_ESP32S3
        bool "Movecall CuiCan (ESP32-S3, GC9A01 240x240)"
        depends on IDF_TARGET_ESP32S3
    config BOARD_TYPE_MOVECALL_MOJI_ESP32S3
        bool "Movecall Moji (ESP32-S3, GC9A01 240x240)"
        depends on IDF_TARGET_ESP32S3
    config BOARD_TYPE_MOVECALL_MOJI2_ESP32C5
        bool "Movecall Moji2 (ESP32-C5, ST77916 360x360)"
        depends on IDF_TARGET_ESP32C5
    config BOARD_TYPE_MOVECALL_MOHI_ESP32C3
        bool "Movecall MoHi (ESP32-C3, ST7789 160x80)"
        depends on IDF_TARGET_ESP32C3
    config BOARD_TYPE_ESP_BOX_3
        bool "Espressif ESP-BOX-3 (ESP32-S3, ILI9341 320x240)"
        depends on IDF_TARGET_ESP32S3
    config BOARD_TYPE_M5STACK_CORE_S3
        bool "M5Stack CoreS3 (ESP32-S3, ILI9341 320x240 Touch)"
        depends on IDF_TARGET_ESP32S3
    config BOARD_TYPE_LILYGO_T_CIRCLE_S3
        bool "LILYGO T-Circle-S3 (ESP32-S3, GC9D01N 160x160)"
        depends on IDF_TARGET_ESP32S3
    config BOARD_TYPE_WAVESHARE_AMOLED_1_8
        bool "Waveshare ESP32-S3-Touch-AMOLED-1.8 (368x448)"
        depends on IDF_TARGET_ESP32S3
    config BOARD_TYPE_ATK_DNESP32S3_BOX0
        bool "ATK-DNESP32S3-BOX0 (ESP32-S3, ST7789 240x240)"
        depends on IDF_TARGET_ESP32S3
    config BOARD_TYPE_MAGICLICK_2P5
        bool "Magiclick 2P5 (ESP32-S3, GC9107 128x128)"
        depends on IDF_TARGET_ESP32S3
endchoice

config BUDDY_DEVICE_NAME_PREFIX
    string "BLE device name prefix"
    default "Claude"
    help
        BLE advertising name prefix. The device will advertise as
        <prefix>-XXYY where XXYY is the last 2 bytes of BT MAC.

config BUDDY_APPROVAL_LONG_PRESS_MS
    int "Long press duration for deny (ms)"
    default 1000
    range 500 3000
    help
        How long the button must be held to send a deny decision.
        Short click sends approve.

config BUDDY_SCREEN_OFF_MS
    int "Screen auto-off timeout (ms)"
    default 30000
    range 5000 300000
    help
        Turn off screen after this period of inactivity.

endmenu
```

## sdkconfig.defaults
```kconfig
CONFIG_COMPILER_OPTIMIZATION_SIZE=y
CONFIG_COMPILER_CXX_EXCEPTIONS=y
CONFIG_COMPILER_CXX_EXCEPTIONS_EMG_POOL_SIZE=1024

CONFIG_BOOTLOADER_COMPILER_OPTIMIZATION_PERF=y
CONFIG_BOOTLOADER_LOG_LEVEL_WARN=y

CONFIG_PARTITION_TABLE_CUSTOM=y
CONFIG_PARTITION_TABLE_CUSTOM_FILENAME="partitions/v2/8m.csv"
CONFIG_PARTITION_TABLE_OFFSET=0x8000

CONFIG_ESPTOOLPY_FLASHSIZE_8MB=y

CONFIG_ESP_TASK_WDT_TIMEOUT_S=10
CONFIG_ESP_MAIN_TASK_STACK_SIZE=8192

# BLE
CONFIG_BT_ENABLED=y
CONFIG_BT_BLUEDROID_ENABLED=y
CONFIG_BT_BLE_42_FEATURES_SUPPORTED=y
CONFIG_BTDM_CTRL_MODE_BLE_ONLY=y

# Board
CONFIG_BOARD_TYPE_MOVECALL_CUICAN_ESP32S3=y

# Console via USB Serial/JTAG (needed for Moji/Moji2 boards)
# CONFIG_ESP_CONSOLE_USB_SERIAL_JTAG=y

# Buddy config
CONFIG_BUDDY_DEVICE_NAME_PREFIX="Claude"
CONFIG_BUDDY_APPROVAL_LONG_PRESS_MS=1000
CONFIG_BUDDY_SCREEN_OFF_MS=30000

CONFIG_NEWLIB_NANO_FORMAT=y
CONFIG_LV_USE_IMGFONT=y
CONFIG_LV_FONT_FMT_TXT_LARGE=y
CONFIG_LV_FONT_MONTSERRAT_12=y
CONFIG_LV_FONT_MONTSERRAT_16=y
CONFIG_LV_FONT_MONTSERRAT_20=y
CONFIG_LV_FONT_MONTSERRAT_28=y
```

## sdkconfig.defaults.buddy
```kconfig
CONFIG_COMPILER_OPTIMIZATION_SIZE=y
CONFIG_COMPILER_CXX_EXCEPTIONS=y
CONFIG_COMPILER_CXX_EXCEPTIONS_EMG_POOL_SIZE=1024

CONFIG_BOOTLOADER_COMPILER_OPTIMIZATION_PERF=y
CONFIG_BOOTLOADER_LOG_LEVEL_WARN=y

CONFIG_PARTITION_TABLE_CUSTOM=y
CONFIG_PARTITION_TABLE_CUSTOM_FILENAME="partitions/v2/8m.csv"
CONFIG_PARTITION_TABLE_OFFSET=0x8000

CONFIG_ESPTOOLPY_FLASHSIZE_8MB=y

CONFIG_ESP_TASK_WDT_TIMEOUT_S=10
CONFIG_ESP_MAIN_TASK_STACK_SIZE=8192

# BLE
CONFIG_BT_ENABLED=y
CONFIG_BT_BLUEDROID_ENABLED=y
CONFIG_BT_BLE_42_FEATURES_SUPPORTED=y
CONFIG_BTDM_CTRL_MODE_BLE_ONLY=y

# No WiFi needed for buddy mode
CONFIG_ESP_WIFI_ENABLED=n

# Board
CONFIG_BOARD_TYPE_MOVECALL_CUICAN_ESP32S3=y

# Buddy config
CONFIG_BUDDY_DEVICE_NAME_PREFIX="Claude"
CONFIG_BUDDY_APPROVAL_LONG_PRESS_MS=1000
CONFIG_BUDDY_SCREEN_OFF_MS=30000

CONFIG_NEWLIB_NANO_FORMAT=y
```

## sdkconfig.defaults.esp32c5
```kconfig
CONFIG_ESPTOOLPY_FLASHSIZE_16MB=y
CONFIG_PARTITION_TABLE_CUSTOM_FILENAME="partitions/v2/16m.csv"

# Console via USB Serial/JTAG
CONFIG_ESP_CONSOLE_USB_SERIAL_JTAG=y

# BLE
CONFIG_BT_ENABLED=y
CONFIG_BT_BLUEDROID_ENABLED=y
CONFIG_BT_BLE_42_FEATURES_SUPPORTED=y

# Board — Moji2 C5
CONFIG_BOARD_TYPE_MOVECALL_MOJI2_ESP32C5=y
```
